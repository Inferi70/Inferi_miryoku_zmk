// Copyright 2021 Manna Harbour
// https://github.com/manna-harbour/miryoku

#include "../miryoku/custom_config.h"
#include "../miryoku/mapping/42/corne.h"
#include "../miryoku/miryoku.dtsi"
#include <dt-bindings/zmk/ext_power.h>

#define COMBO(NAME, BINDINGS, KEYPOS) \
  combo_##NAME { \
    timeout-ms = <100>; \
    bindings = <BINDINGS>; \
    key-positions = <KEYPOS>; \
    layers = <10>; \
  };

/ {
     behaviors {
                     m_td0: tap_dance_mod_tap_gaming_num1_2 {
                     compatible = "zmk,behavior-tap-dance";
                     #binding-cells = <0>;
                     tapping-term-ms = <225>;
                     bindings = <&mt N1 Q>, <&kp N2>;
                     };
             };

      combos {
                compatible = "zmk,combos";
                      
                COMBO(one, &kp N1, 1 37)
                COMBO(two, &kp N2, 2 37)
                COMBO(three, &kp N3, 4 37)
                COMBO(four, &kp N4, 5 37)
        };
};
